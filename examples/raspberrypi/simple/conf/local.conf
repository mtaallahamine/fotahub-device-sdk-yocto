## examples/raspberrypi/simple/conf/local.conf
```bitbake
CONF_VERSION = "1"

MACHINE = 'raspberrypi3'

# Set root password
INHERIT += "extrausers"
EXTRA_USERS_PARAMS = "usermod -P root root;"

# Comment this line to disable SSH server on target
EXTRA_IMAGE_FEATURES += "${@bb.utils.contains('DISTRO', 'fotahub-os', 'ssh-server-dropbear', '', d)}"

# Comment this line to disable SSH-ing into target as root 
EXTRA_IMAGE_FEATURES += "allow-empty-password"

DL_DIR = "/build/yocto/downloads"

OSTREE_GPG_VERIFY = "false"
OSTREEPUSH_SSH_USER = "root"
OSTREEPUSH_SSH_PASS = "root"

OS_UPDATE_VERIFICAITON_COMMAND = "bash -c 'echo \"The downloaded OS update revision $1 looks good!\"'"
OS_UPDATE_SELF_TEST_COMMAND = "bash -c 'echo \"The freshly activated OS update runs very well!\"'"

# Uncomment to add some extra packages to OS image
# IMAGE_INSTALL_append = " nano figlet pv"
```
